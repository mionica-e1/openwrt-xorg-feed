## wm/weston/Config.in
```kconfig
menu "weston misc support"

	config WESTON_LAUNCH
		depends on PACKAGE_libpam
		bool
		prompt "build weston-launch"

endmenu
```

## xorg/lib/libX11/Config.in
```kconfig
# libX11 config
config DISPLAY_X11_SUPPORT
	depends on DISPLAY_SUPPORT
	bool
	default n
```
